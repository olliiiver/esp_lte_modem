## components/modem/Kconfig
```kconfig
menu "ESP-MODEM"

    config COMPONENT_MODEM_APN
        string "Set Access Point Name (APN)"
        default "CMNET"
        help
            Logical name which is used to select the GGSN or the external packet data network.

    config COMPONENT_MODEM_APN
        string "Set Personal identification number (PIN)"
        default ""
        help
            PIN which is used to unlock the SIM card.

endmenu
```
